// Placa: DOIT ESP32 DEVKIT V1
// Upload Speed: 115200
// Flash freq: 40MHz
// Core Debug Level: Ninguno

// VERSION FFT dos canales: se usa el canal del pecho para la respiración y el 
// canal de la zona inferior del colchón para el pulso. 
// Se hace la FFT en el pulso para sacar la frecuencia fundamental. 

#include "arduinoFFT.h"
#include <SOSFilter.h>
#include "BluetoothSerial.h"

// Analog Input
#define ANALOG_PIN_0 39 // Analog Input: ADC_1_0 pin ==> GPIO39 // Para la respiración
#define ANALOG_PIN_1 34 // GPIO34 // Para el pulso

// Para la FFT
#define SCL_INDEX 0x00
#define SCL_TIME 0x01
#define SCL_FREQUENCY 0x02
#define SCL_PLOT 0x03

// Para el Bluetooth
BluetoothSerial ESP_BT; //Object for Bluetooth
int incoming;
int LED= 2;

float  senal_filtro_h;
float  muestra1b, muestra2b, muestra3b;
float  muestra_h, muestra_b, muestra_filtrada,muestra_filtrada_y;
int  H_R, B_R;
boolean  actividad;

int longitud_vectores=1000;
int  HR_vector[1000], BR_vector[1000], ACT_vector[1000];
//int *HR_vector, *BR_vector, *ACT_vector;
float maximo;
int contador;
int num_respiraciones;
int j;
int limite_ruido_resp=1000; // en amplitud
boolean fin=0;
boolean wait=0;
int longitud_ventana;
int num_promedio=64;
float t1, t2, t_max;
float HR_max=120; //ppm
boolean minimo_detectado;

int t_ini;

// Flags para el BT
boolean inicio_datos = 0;
boolean envio_datos = 0;

arduinoFFT FFT = arduinoFFT(); /* Create FFT object */
const uint16_t samples = 4096; //This value MUST ALWAYS be a power of 2
double  velocidad_muestreo=200; //muestras por seg //Hz, must be less than 10000 due to ADC
double vReal[samples];
double vImag[samples];

//Señales de prueba
//float senal_b[]={287.6875,289.09375,290.0625,291.04687,288.9375,290.26562,290.73437,290.84375,290.125,289.71875,289.04687,287.95312,290.29687,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290.40625,289.8125};

// Variables para implementar las interrupciones con el Timer
// Fuente: https://techtutorialsx.com/2017/10/07/esp32-arduino-timer-interrupts/
volatile int interruptCounter;
int totalInterruptCounter;
hw_timer_t *timer = NULL;   /* se crea un puntero de tipo hw_timer para la configuración del timer */
portMUX_TYPE timerMux = portMUX_INITIALIZER_UNLOCKED;

// ISR
void IRAM_ATTR onTimer() {
  portENTER_CRITICAL_ISR(&timerMux);
  interruptCounter++;
  portEXIT_CRITICAL_ISR(&timerMux);
}

// Definición de los filtros

// Pulso detectado entre 24 y 162 ppm
// Para 200 muestras por segundo

const double sos_h[][6] = {                 // filtro pulso 1: paso alta, IIR, orden 2, 0.1-0.8 Hz, 20 dB
    {1, -2, 1,  1, -1.98598595723005, 0.986083473009604} 
};
const double g_h[] = {0.993017357559912};
SOSFilter<1> filter_h(sos_h, g_h);

const double sos_h2[][6] = {                 // filtro pulso 3: paso bajo, IIR, mínimo orden, 1-10 Hz, 80 dB
    {1, 2, 1,  1, -1.96698444058921, 0.969464886120290},
    {1, 2, 1,  1, -1.91956461799301, 0.921985265243733},
    {1, 1, 0,  1, -0.951024900504297,  0}
};
const double g_h2[] = {0.000620111382771082, 0.000605161812680899, 0.0244875497478514};
SOSFilter<3> filter_h2(sos_h2, g_h2);


// Respiración entre 0 y 120 rpm
const double sos_b[][6] = {              // filtro resp: paso baja, IIR, mínimo orden, 0.1-1.5 Hz, 50 dB
    {1, 2, 1,  1, -1.99305810207877, 0 .993105797090774},
    {1, 1, 0,  1, -0.993105714885021, 0}
};
const double g_b[] = {0.0000119237530005953, 0.00344714255748968};
SOSFilter<2> filter_b(sos_b, g_b);

void setup(){
  
  Serial.begin(115200);

  // Inicializamos el BT
  ESP_BT.begin("ESP32_SENSOBED"); 						// Nombre del dispositivo bt
  Serial.println("Bluetooth device is ready to pair");
  pinMode (LED, OUTPUT);								//Specify that LED pin is output

// Setup del timer para la interrupcion      
  timer = timerBegin(0, 80, true);              // timerBegin(n_timer, prescaler, ascendente (true)) 
                                                // La frecuencia se reduce a 80MHz/80=1MHz, timer cuenta uno cada 1us
  timerAttachInterrupt(timer, &onTimer, true);  // (nombre_timer, &nombre_rutina, true = (interrupcion genera edge))
                                                // Asociación de una rutina al desbordamiento del timer (interrupción)  

  ////// Modificar
  timerAlarmWrite(timer, 5000, true);         	// (nombre_timer, n_saltos_timer, true = (cuando salta la int, el timer empieza de nuevo a contar))
												// Se produce una interrupcion cada 5000us = 5ms

  // Setup para la entrada analogica
  analogSetClockDiv(1); 					  	// analogSetClockDiv(attenuation): set the divider for the ADC clock. 
												// Default is 1. Range: 1 to 255
												// El ADC es de 12 bits
  delay(1000); 									// give me time to bring up serial monitor

  // Inicializamos las variables. 
  num_respiraciones=0;
  actividad=0;
  muestra_h=0;
  muestra_b=0;
  muestra_filtrada=0;
  muestra1b=0;
  muestra2b=0;
  muestra3b=0;
  contador=0;
  j=0;
  t1=0;
  t2=0;
  maximo=0;
  minimo_detectado=0;
  longitud_ventana = samples;
  t_max = 0.4;
  
  /*HR_vector = (int*)malloc(longitud_vectores);
  BR_vector = (int*)malloc(longitud_vectores);
  ACT_vector = (int*)malloc(longitud_vectores);*/
  for (int i=0;i<=longitud_vectores;i++){
    HR_vector[i]=0;
    BR_vector[i]=0;
    ACT_vector[i]=0;
  }
  for (int i=0;i<=samples;i++){
    vReal[i]=0;
    vImag[i]=0;
  }

}

void loop(){

incoming = 0;
if (ESP_BT.available()){ 		//Check if we receive anything from Bluetooth
  incoming = ESP_BT.read(); 	//Read what we recevive   
  if (incoming == 49){ 			// En ASCII, el "1" es el codigo 49
	inicio_datos = 1;
	contador = 0;
	timerAlarmEnable(timer);	// Inicio del timer
	digitalWrite(LED, HIGH); 	// Encendemos el LED
  }
  else if (incoming == 48){ 	// En ASCII, es "0"
	inicio_datos = 0;
	digitalWrite(LED, LOW); 	// Apagamos el LED
  }
  else if (incoming == 50){ 	// En ASCII, es "2"
	envio_datos = 1;
  }
}

if(wait == 0){
    
  if(inicio_datos == 1){
  
    if (interruptCounter > 0) {   // se ejecuta por interrupción
  
      portENTER_CRITICAL(&timerMux);
      interruptCounter--;
      portEXIT_CRITICAL(&timerMux);
      totalInterruptCounter++;
    
      muestra_h=0;
      muestra_b=0;
      for (int i=0; i<num_promedio; i++) {
        muestra_b = muestra_b + analogRead(ANALOG_PIN_0);
        muestra_h = muestra_h + analogRead(ANALOG_PIN_1);
      }
      muestra_b = muestra_b/num_promedio;
      muestra_h = muestra_h/num_promedio;
      // Para usar el vector de la señal de prueba y mostrarlo. 
      //muestra_h=senal_b[j];
      //Serial.println(muestra_h,5);
  
      // DETECCIÓN DE ACTIVIDAD: del canal del pulso
      if ((muestra_h>=4000)||(muestra_h<=100)){
        actividad=1;
      }
     
     // DETECCIÓN DE RESPIRACIÓN  
      muestra_filtrada=filter_b.filter(muestra_b);
      //Serial.println(muestra_filtrada,5);
            
      if (j==0){   //almacena las primeras 3
        muestra1b=muestra_filtrada;
      }
      if (j==1){
        muestra2b=muestra_filtrada;
      }
      if (j==2){
        muestra3b=muestra_filtrada;
      }
      if(muestra1b<=muestra2b){   		// comprueba si la muestra2 es maxima
        if (muestra3b<muestra2b){
          maximo=muestra2b;
          minimo_detectado=0;
        }
      }
      if(muestra1b>muestra2b){
        if (muestra3b>=muestra2b){      // si la muestra2 es mínima
          if (maximo-muestra2b>limite_ruido_resp){
            if(minimo_detectado==0){
              num_respiraciones=num_respiraciones+1;
              minimo_detectado=1;
            }
          }
        }
      }
      else if(muestra1b==muestra2b){
        if (muestra3b>muestra2b){
          if (maximo-muestra2b>limite_ruido_resp){
            if(minimo_detectado==0){
              num_respiraciones=num_respiraciones+1;
              minimo_detectado=1;
            }
          }
        }
      }
      muestra1b=muestra2b;
      muestra2b=muestra3b;
      muestra3b=muestra_filtrada;
  
      
      // DETECCIÓN DE PULSO
      senal_filtro_h=filter_h.filter(muestra_h);
      if (senal_filtro_h<0){
        senal_filtro_h = 0;  
      }
      //Serial.println(senal_filtro_h,5);
      muestra_filtrada_y=senal_filtro_h*senal_filtro_h; // se eleva al cuadrado la señal filtrada
      muestra_filtrada=filter_h2.filter(muestra_filtrada_y); // se aplica el segundo filtro
      //Serial.println(muestra_filtrada,5);
      vReal[j]=muestra_filtrada;
      vImag[j]=0;
      //int t_final = millis();
      //Serial.println(t_final);
      j=j+1;
      
      if (j==longitud_ventana){
        j=0;

        FFT.Windowing(vReal, samples, FFT_WIN_TYP_HAMMING, FFT_FORWARD);  /* Weigh data */
        FFT.Compute(vReal, vImag, samples, FFT_FORWARD); /* Compute FFT */
        FFT.ComplexToMagnitude(vReal, vImag, samples); /* Compute magnitudes */
        double x = FFT.MajorPeak(vReal, samples, velocidad_muestreo);
        //Serial.print("frecuencia: ");
        //Serial.println(x, 6); //Print out what frequency is the most dominant.*/
        //int t_final = millis();
        //Serial.println(t_final-t_ini);
        H_R = (int) 60*x;
        
        B_R= num_respiraciones*velocidad_muestreo*60/(float)longitud_ventana; //respiraciones por minuto
        
        Serial.print("ACT: ");
        Serial.println(actividad);
        Serial.println();
        Serial.print("HR: ");
        Serial.println(H_R);
        Serial.println();
        Serial.print("BR: ");
        Serial.print(num_respiraciones);
        Serial.print(" ");
        Serial.println(B_R);
        //Serial.println(contador);
        Serial.println("---------------------------");
    
        HR_vector[contador]=H_R;
        BR_vector[contador]=B_R;
        ACT_vector[contador]=actividad;

        for (int i=0;i<=samples;i++){
          vReal[i]=0;
          vImag[i]=0;
        }
        //fin=1;
        
        actividad=0;
        num_respiraciones=0;
        contador++;  

         // Se envían los datos a la app cada 1000 valores y se siguen capturando otros 1000 datos.  
        if(contador==80){
            timerAlarmDisable(timer);
            
            // Enviamos los datos de pulso cardiaco
            for (int i = 0; i<contador; i++) {
              ESP_BT.print(HR_vector[i]);
              ESP_BT.print("\n");
            }
            ESP_BT.print("#"); // Carácter fin de datos
            Serial.println("FIN array HR-1000");
        
            // Enviamos los datos de respiracion
            for (int i = 0; i<contador; i++) {
              ESP_BT.print(BR_vector[i]);
              ESP_BT.print("\n");
            }
            ESP_BT.print("#"); // Carácter fin de datos
            Serial.println("FIN array BR-1000");
        
            // Enviamos los datos de actividad
            for (int i = 0; i<contador; i++) {
              ESP_BT.print(ACT_vector[i]);
              ESP_BT.print("\n");
            }
            ESP_BT.print("#"); // Carácter fin de datos
            Serial.println("FIN array BR-1000");
            contador = 0;
            // Se reinicia el vector para seguir rellenando desde 0 otra vez. 
            for (int i=0;i<=longitud_vectores;i++){
              HR_vector[i]=0;
              BR_vector[i]=0;
              ACT_vector[i]=0;
            }
            timerAlarmEnable(timer);
          
        }
        // Para evitar que de error por escribir en posición superior al tamaño del vector. 
        if(contador>=longitud_vectores){
          wait=1;
        }
        t1=0;
        t2=0;
        minimo_detectado=0;
		}
      //while(fin);
      }
   }//fin de if de toma de datos
 }// fin del wait








  if (envio_datos == 1){

    timerAlarmDisable(timer);

    // Para resolver el problema con vectores menores en Android
    // Si mandas menos, hay dos fin de carácter # en la misma trama, y el método de 
    // separar en Android, no sirve. 
    if (contador<80){
      contador = 80;
    }
    
    // Enviamos los datos de pulso cardiaco
    for (int i = 0; i<contador; i++) {
      ESP_BT.print(HR_vector[i]);
      ESP_BT.print("\n");
    }
    ESP_BT.print("#"); // Carácter fin de datos
    Serial.println("FIN array de latidos");

    // Enviamos los datos de respiracion
    for (int i = 0; i<contador; i++) {
      ESP_BT.print(BR_vector[i]);
      ESP_BT.print("\n");
    }
    ESP_BT.print("#"); // Carácter fin de datos
    Serial.println("FIN array de respiraciones");

    // Enviamos los datos de actividad
    for (int i = 0; i<contador; i++) {
      ESP_BT.print(ACT_vector[i]);
      ESP_BT.print("\n");
    }
    // En este caso ya no hace falta carácter de fin de datos
    Serial.println("FIN array de actividad");
    envio_datos = 0;
    
    for (int i=0;i<=longitud_vectores;i++){
      HR_vector[i]=0;
      BR_vector[i]=0;
      ACT_vector[i]=0;
    }
    
  }//fin if envio de datos

}
